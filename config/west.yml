## config/west.yml
```yaml
manifest:
  remotes:
    - name: zmkfirmware
      url-base: https://github.com/zmkfirmware

    - name: 280Zo
      url-base: https://github.com/280Zo

    - name: englmaxi
      url-base: https://github.com/englmaxi

  projects:
    - name: zmk
      remote: zmkfirmware
      # Pinned: 2026-05-30, the last commit before this config was validated.
      revision: 26246da1b69733b224a33d82b33750541cd5933a
      import: app/west.yml

    - name: zmk-pmw3610-driver
      remote: 280Zo
      revision: main

    - name: zmk-dongle-display
      remote: englmaxi
      revision: main

  self:
    path: config
```
